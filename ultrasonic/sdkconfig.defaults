## ultrasonic/sdkconfig.defaults
```kconfig
CONFIG_IDF_TARGET="esp32s3"

# Partition table
CONFIG_PARTITION_TABLE_SINGLE_APP=y

# UART1 for A02YYUW
CONFIG_ESP_CONSOLE_UART_DEFAULT=y
CONFIG_ESP_CONSOLE_UART_BAUDRATE=115200

# I2C
CONFIG_I2C_ENABLE_DEBUG_LOG=y

# FreeRTOS
CONFIG_FREERTOS_HZ=1000

# Log level
CONFIG_LOG_DEFAULT_LEVEL_INFO=y
```
